## prj.conf
```kconfig
CONFIG_IPM=y
CONFIG_IPM_QUARK_SE=y
CONFIG_IPM_QUARK_SE_MASTER=y
CONFIG_IPM_CONSOLE_RECEIVER=y
CONFIG_STDOUT_CONSOLE=y
CONFIG_GPIO=y
CONFIG_ARC_INIT=n
CONFIG_USB=y
CONFIG_USB_DW=y
CONFIG_USB_DEVICE_STACK=y
CONFIG_USB_DW_DEBUG=n
CONFIG_USB_CDC_ACM=y
CONFIG_USB_DEBUG=n
CONFIG_SERIAL=y
CONFIG_UART_INTERRUPT_DRIVEN=y
CONFIG_UART_LINE_CTRL=y
CONFIG_COMPILER_OPT="-O0"
CONFIG_GPIO_QMSI=y
CONFIG_GPIO_QMSI_1_NAME="GPIO_1"
CONFIG_GPIO_QMSI_1_PRI=2
CONFIG_USB_CDC_ACM_CONFIGURABLE=y
CONFIG_CODK_FIRMWARE_VERSION=y
CONFIG_PHYS_RAM_ADDR=0xA8001000
CONFIG_RAM_SIZE=36
CONFIG_ROM_SIZE=144
```

## src/main.c
```c
/*
 * Copyright (c) 2017 Intel Corporation
 *
 * Licensed under the Apache License, Version 2.0 (the "License");
 * you may not use this file except in compliance with the License.
 * You may obtain a copy of the License at
 *
 *     http://www.apache.org/licenses/LICENSE-2.0
 *
 * Unless required by applicable law or agreed to in writing, software
 * distributed under the License is distributed on an "AS IS" BASIS,
 * WITHOUT WARRANTIES OR CONDITIONS OF ANY KIND, either express or implied.
 * See the License for the specific language governing permissions and
 * limitations under the License.
 */

#include <zephyr.h>
#include <misc/printk.h>
#include <gpio.h>
#include "soc.h"

#include "sharedmemory_com.h"
#include "soc_ctrl.h"
#include "cdcacm_serial.h"
#include "fault_led.h"
#include "curie_shared_mem.h"
#include <string.h>
#include <cdc_acm_config.h>
#include <factory_data.h>
#include <linker-defs.h>

#define SOFTRESET_INTERRUPT_PIN		0

/* size of stack area used by each thread */
#define MAIN_STACKSIZE      2048
#define CDCACM_STACKSIZE    1024
#define RESET_STACKSIZE     384
#define USBSERIAL_STACKSIZE 1024
#define FAULTLED_STACKSIZE  256

/* scheduling priority used by each thread */
#define PRIORITY 7
#define TASK_PRIORITY 8

#define ARDUINO_101_VID		0x8087
#define ARDUINO_101_PID		0x0AB6

#define MAX_DESCRIPTOR_LENGTH	64

char __noinit __stack cdcacm_setup_stack_area[CDCACM_STACKSIZE];
char __noinit __stack baudrate_reset_stack_area[RESET_STACKSIZE];
char __noinit __stack usb_serial_stack_area[USBSERIAL_STACKSIZE];
char __noinit __stack fault_led_stack_area[FAULTLED_STACKSIZE];

const char *vendor = "Intel";
const char *product =  "Arduino 101";
const char *serial = "00.01";

DEFINE_CODK_FIRMWARE_VERSION("firmware_1.8.0_arduino101");

struct gpio_callback cb;

void softResetButton();

static void softReset_button_callback(struct device *port, struct gpio_callback *cb, uint32_t pins)
{
	soft_reboot();
}

void copy_device_descriptor(char *dest, uint8_t *source, const char *default_value, uint8_t len, uint8_t max)
{
	if ((len > 0) && (len < max))
	{
		memcpy(dest, source, len);
		dest[len] = '\0';
	}
	else
	{
		memcpy(dest, default_value, strlen(default_value));
		dest[strlen(default_value)] = '\0';
	}
}

void cdc_acm_descriptor_callback (cdc_acm_cfg_t *cfg)
{
	customer_data_t *otp_data = (customer_data_t *)CUSTOMER_DATA_ADDRESS;

	//read the USB descriptors from OTP and use some default values if it has not been properly populated
	copy_device_descriptor(cfg->vendor_string, otp_data->vendor_name, vendor,
		otp_data->vendor_name_len, MAX_DESCRIPTOR_LENGTH);

	copy_device_descriptor(cfg->product_string, otp_data->board_name, product,
		otp_data->board_name_len, MAX_DESCRIPTOR_LENGTH);

	copy_device_descriptor(cfg->serial_string, otp_data->product_sn, serial,
		otp_data->product_sn_len, MAX_DESCRIPTOR_LENGTH);

	if((otp_data->product_vid != 0xFFFF) && (otp_data->product_vid != 0x0000)
		&& (otp_data->product_pid != 0xFFFF) && (otp_data->product_pid != 0x0000))
	{
		cfg->vendor_id = otp_data->product_vid;
		cfg->product_id = otp_data->product_pid;
	}
	else
	{
		//use VID/PID of Arduino 101
		cfg->vendor_id = ARDUINO_101_VID;
		cfg->product_id = ARDUINO_101_PID;
	}
}

void threadMain(void *dummy1, void *dummy2, void *dummy3)
{

	init_cdc_acm();
	softResetButton();

	curie_shared_data->error_code = 0;
    
	//start ARC core
	uint32_t *reset_vector;
	reset_vector = (uint32_t *)RESET_VECTOR;
	start_arc(*reset_vector);

	k_thread_spawn(cdcacm_setup_stack_area, CDCACM_STACKSIZE, cdcacm_setup, NULL, NULL,
			NULL, TASK_PRIORITY, 0, K_NO_WAIT);
	
	k_thread_spawn(baudrate_reset_stack_area, RESET_STACKSIZE, baudrate_reset, NULL, NULL,
			NULL, TASK_PRIORITY, 0, K_NO_WAIT);
	
	k_thread_spawn(usb_serial_stack_area, USBSERIAL_STACKSIZE, usb_serial, NULL, NULL,
			NULL, TASK_PRIORITY, 0, K_NO_WAIT);

	k_thread_spawn(fault_led_stack_area, FAULTLED_STACKSIZE, check_arc_error, NULL, NULL,
			NULL, TASK_PRIORITY, 0, K_NO_WAIT);

}

void softResetButton()
{
	struct device *aon_gpio;
	char* gpio_aon_0 = (char*)"GPIO_1";
	aon_gpio = device_get_binding(gpio_aon_0);
	if (!aon_gpio) 
	{
		return;
	}

	gpio_init_callback(&cb, softReset_button_callback, BIT(SOFTRESET_INTERRUPT_PIN));
	gpio_add_callback(aon_gpio, &cb);

	gpio_pin_configure(aon_gpio, SOFTRESET_INTERRUPT_PIN,
			   GPIO_DIR_IN | GPIO_INT | GPIO_INT_EDGE |
			   GPIO_INT_ACTIVE_LOW | GPIO_INT_DEBOUNCE);

	gpio_pin_enable_callback(aon_gpio, SOFTRESET_INTERRUPT_PIN);
}

K_THREAD_DEFINE(threadMain_id, MAIN_STACKSIZE, threadMain, NULL, NULL, NULL,
		PRIORITY, 0, K_NO_WAIT);
```

## src/main.cpp
```c
/*
 * Copyright (c) 2016 Intel Corporation
 *
 * Licensed under the Apache License, Version 2.0 (the "License");
 * you may not use this file except in compliance with the License.
 * You may obtain a copy of the License at
 *
 *     http://www.apache.org/licenses/LICENSE-2.0
 *
 * Unless required by applicable law or agreed to in writing, software
 * distributed under the License is distributed on an "AS IS" BASIS,
 * WITHOUT WARRANTIES OR CONDITIONS OF ANY KIND, either express or implied.
 * See the License for the specific language governing permissions and
 * limitations under the License.
 */


#include <stdio.h>
#include <device.h>
#include <zephyr.h>
#include <gpio.h>
#include "soc.h"

#include "sharedmemory_com.h"
#include "soc_ctrl.h"
#include "cdcacm_serial.h"
#include "curie_shared_mem.h"

#if defined(CONFIG_STDOUT_CONSOLE)
#include <stdio.h>
#define PRINT           printf
#else
#include <misc/printk.h>
#define PRINT           printk
#endif

#define SOFTRESET_INTERRUPT_PIN		0

struct gpio_callback cb;

void softResetButton();

static void softReset_button_callback(struct device *port, struct gpio_callback *cb, uint32_t pins)
{
	soft_reboot();
}

void main(void)
{
	init_cdc_acm();
	softResetButton();
	init_sharedMemory_com();
    
	//start ARC core
	uint32_t *reset_vector;
	reset_vector = (uint32_t *)RESET_VECTOR;
	start_arc(*reset_vector);

	task_start(CDCACM_SETUP);
	task_start(BAUDRATE_RESET);
	task_start(USB_SERIAL);
}

void softResetButton()
{
	struct device *aon_gpio;
	char* gpio_aon_0 = (char*)"GPIO_AON_0";
	aon_gpio = device_get_binding(gpio_aon_0);
	if (!aon_gpio) 
	{
		return;
	}

	gpio_init_callback(&cb, softReset_button_callback, BIT(SOFTRESET_INTERRUPT_PIN));
	gpio_add_callback(aon_gpio, &cb);

	gpio_pin_configure(aon_gpio, SOFTRESET_INTERRUPT_PIN,
			   GPIO_DIR_IN | GPIO_INT | GPIO_INT_EDGE |
			   GPIO_INT_ACTIVE_LOW | GPIO_INT_DEBOUNCE);

	gpio_pin_enable_callback(aon_gpio, SOFTRESET_INTERRUPT_PIN);
}
```

## src/cdc_acm.h
```c
/***************************************************************************
 *
 * This file is provided under a dual BSD/GPLv2 license.  When using or
 * redistributing this file, you may do so under either license.
 *
 * GPL LICENSE SUMMARY
 *
 * Copyright(c) 2015,2016 Intel Corporation.
 *
 * This program is free software; you can redistribute it and/or modify
 * it under the terms of version 2 of the GNU General Public License as
 * published by the Free Software Foundation.
 *
 * This program is distributed in the hope that it will be useful, but
 * WITHOUT ANY WARRANTY; without even the implied warranty of
 * MERCHANTABILITY or FITNESS FOR A PARTICULAR PURPOSE.  See the GNU
 * General Public License for more details.
 *
 *
 * BSD LICENSE
 *
 * Copyright(c) 2015,2016 Intel Corporation.
 *
 * Redistribution and use in source and binary forms, with or without
 * modification, are permitted provided that the following conditions
 * are met:
 *
 * * Redistributions of source code must retain the above copyright
 * notice, this list of conditions and the following disclaimer.
 * * Redistributions in binary form must reproduce the above copyright
 * notice, this list of conditions and the following disclaimer in
 * the documentation and/or other materials provided with the
 * distribution.
 * * Neither the name of Intel Corporation nor the names of its
 * contributors may be used to endorse or promote products derived
 * from this software without specific prior written permission.
 *
 * THIS SOFTWARE IS PROVIDED BY THE COPYRIGHT HOLDERS AND CONTRIBUTORS
 * "AS IS" AND ANY EXPRESS OR IMPLIED WARRANTIES, INCLUDING, BUT NOT
 * LIMITED TO, THE IMPLIED WARRANTIES OF MERCHANTABILITY AND FITNESS FOR
 * A PARTICULAR PURPOSE ARE DISCLAIMED. IN NO EVENT SHALL THE COPYRIGHT
 * OWNER OR CONTRIBUTORS BE LIABLE FOR ANY DIRECT, INDIRECT, INCIDENTAL,
 * SPECIAL, EXEMPLARY, OR CONSEQUENTIAL DAMAGES (INCLUDING, BUT NOT
 * LIMITED TO, PROCUREMENT OF SUBSTITUTE GOODS OR SERVICES; LOSS OF USE,
 * DATA, OR PROFITS; OR BUSINESS INTERRUPTION) HOWEVER CAUSED AND ON ANY
 * THEORY OF LIABILITY, WHETHER IN CONTRACT, STRICT LIABILITY, OR TORT
 * (INCLUDING NEGLIGENCE OR OTHERWISE) ARISING IN ANY WAY OUT OF THE USE
 * OF THIS SOFTWARE, EVEN IF ADVISED OF THE POSSIBILITY OF SUCH DAMAGE.
 *
 ***************************************************************************/

#ifndef __CDC_ACM_H__
#define __CDC_ACM_H__

/* Data structure for GET_LINE_CODING / SET_LINE_CODING class requests */
struct cdc_acm_line_coding {
	uint32_t dwDTERate;
	uint8_t bCharFormat;
	uint8_t bParityType;
	uint8_t bDataBits;
} __packed;

struct cdc_acm_notification {
	uint8_t bmRequestType;
	uint8_t bNotificationType;
	uint16_t wValue;
	uint16_t wIndex;
	uint16_t wLength;
	uint16_t data;
} __packed;

/* Max packet size for Bulk endpoints */
#define CDC_BULK_EP_MPS		64

/* Max packet size for Interrupt endpoints */
#define CDC_INTERRUPT_EP_MPS	16

/* Max CDC ACM class request max data size */
#define CDC_CLASS_REQ_MAX_DATA_SIZE	8

#define CDC_NUM_CONF	0x01   /* Number of configurations for the USB Device */
#define CDC_NUM_ITF		0x02   /* Number of interfaces in the configuration */
#define CDC1_NUM_EP		0x01   /* Number of Endpoints in the first interface */
#define CDC2_NUM_EP		0x02   /* Number of Endpoints in the second interface */

#define CDC_ENDP_INT	0x81
#define CDC_ENDP_OUT	0x03
#define CDC_ENDP_IN		0x84

/* Decriptor size in bytes */
#define USB_HFUNC_DESC_SIZE		5
#define USB_CMFUNC_DESC_SIZE	5
#define USB_ACMFUNC_DESC_SIZE	4
#define USB_UFUNC_DESC_SIZE		5

/* Descriptor type */
#define CS_INTERFACE		0x24
#define CS_ENDPOINT			0x25

/* Descriptor subtype */
#define USB_HFUNC_SUBDESC	0x00
#define USB_CMFUNC_SUBDESC	0x01
#define USB_ACMFUNC_SUBDESC	0x02
#define USB_UFUNC_SUBDESC	0x06

/* Class specific request */
#define CDC_SET_LINE_CODING			0x20
#define CDC_GET_LINE_CODING			0x21
#define CDC_SET_CONTROL_LINE_STATE	0x22

/* Control line state signal bitmap */
#define CDC_CONTROL_LINE_STATE_DTR	0x1
#define CDC_CONTROL_LINE_STATE_RTS	0x2

/* Serial state notification bitmap*/
#define CDC_CONTROL_SERIAL_STATE_DCD	0x1
#define CDC_CONTROL_SERIAL_STATE_DSR	0x2

/* Serial state notification timeout */
#define CDC_CONTROL_SERIAL_STATE_TIMEOUT_US 100000

/* Size in bytes of the configuration sent to
 * the Host on GetConfiguration() request
 * For Communication Device: CONF + (2 x ITF) +
 * (3 x EP) + HF + CMF + ACMF + UF -> 67 bytes
 */
#define CDC_CONF_SIZE   (USB_CONFIGURATION_DESC_SIZE + \
	(2 * USB_INTERFACE_DESC_SIZE) + (3 * USB_ENDPOINT_DESC_SIZE) + 19)

#endif /* __CDC_ACM_H__ */
```

## src/cdcacm_serial.c
```c
#include <stdio.h>
#include <device.h>
#include <zephyr.h>
#include <uart.h>
#include <gpio.h>
#include "soc.h"
#include <ipm.h>
#include <ipm/ipm_quark_se.h>

#include "soc_ctrl.h"
#include "curie_shared_mem.h"

/**
 * Use the following defines just to make the tips of your finger happier.
 */
#define Rx_BUFF curie_shared_data->cdc_acm_shared_rx_buffer.data
#define Rx_HEAD curie_shared_data->cdc_acm_shared_rx_buffer.head
#define Rx_TAIL curie_shared_data->cdc_acm_shared_rx_buffer.tail
#define Tx_BUFF curie_shared_data->cdc_acm_shared_tx_buffer.data
#define Tx_HEAD curie_shared_data->cdc_acm_shared_tx_buffer.head
#define Tx_TAIL curie_shared_data->cdc_acm_shared_tx_buffer.tail
#define SBS     SERIAL_BUFFER_SIZE

#define RESET_BAUD              1200
#define BAUDRATE_RESET_SLEEP    50

/* Make sure BUFFER_LENGTH is not bigger then shared ring buffers */
#define BUFFER_LENGTH		128
#define MBOX_MSG_LENGTH		16

#define USB_CONNECTED	    0x04
#define USB_DISCONNECTED    0x05

#define SERIAL_READ_TIMEOUT	1000
#define CDCACM_TX_DELAY		5000
#define CDCACM_TX_TIMEOUT	5000
#define CDCACM_TX_TIMEOUT_DELAY	10
#define CDCACM_TX_LOOP_TIMEOUT	100000

#define SCSS_RSTC   (uint32_t*)0xb0800570

#define RSTC_WARM_RESET	(1 << 1)
#define RSTC_COLD_RESET (1 << 3)

#define TXRX_LED 12

typedef enum {
	ACM_RX_DISABLED,
	ACM_RX_READY,
	ACM_RX_PENDING
} acm_rx_states;

typedef enum {
	ACM_TX_DISABLED,
	ACM_TX_READY,
	ACM_TX_PENDING
} acm_tx_states;

struct device *dev;
struct device *gpio_dev;
bool usbSetupDone = false;
bool enableReboot = false;
bool first_ipm_message = true;
int cdc_acm_tx_loop_timeout = 0;

// buffers
static unsigned char data_buf[BUFFER_LENGTH];

static volatile uint32_t acm_rx_state = ACM_RX_DISABLED;
static volatile uint32_t acm_tx_state = ACM_TX_DISABLED;

static volatile bool data_transmitted;
static volatile bool data_arrived = false;

#define USB_GRSTCTL 0xB0500010

/* Sending messages on channel 6 */
QUARK_SE_IPM_DEFINE(cdc_ipm_send, 6, QUARK_SE_IPM_OUTBOUND);

/* Receiving messages on channel 7 */
QUARK_SE_IPM_DEFINE(cdc_ipm_receive, 7, QUARK_SE_IPM_INBOUND);

static struct device *ipm;
static struct device *rec_ipm;
static volatile uint32_t val;
static volatile bool received;

void flush_usb_txfifo()
{
	*(uint32_t*)USB_GRSTCTL = *(uint32_t*)USB_GRSTCTL | 0x00000420;
}

static void interrupt_handler(struct device *dev)
{
	uart_irq_update(dev);

	if (uart_irq_tx_ready(dev)) {
		data_transmitted = true;
	}

	if (uart_irq_rx_ready(dev)) {
		data_arrived = true;
	}
}

static void read_data(struct device *dev, int *bytes_read)
{
	int timeout = SERIAL_READ_TIMEOUT;

	while (!data_arrived && !timeout)
		--timeout;

	data_arrived = false;

	/* Read all data */
	*bytes_read = uart_fifo_read(dev, data_buf, sizeof(data_buf));
}

static void write_data(struct device *dev, const char *buf, int len)
{
	uart_irq_tx_enable(dev);
	for(uint8_t i = 0; i < len; i+=4)
	{
		data_transmitted = false;
		int timeout = 0;
		if((i+4) <= len)
		{
			uart_fifo_fill(dev, buf+i, 4);
		}
		else
		{
			uart_fifo_fill(dev, buf+i, len-i);	
		}
		while (data_transmitted == false);
		{
			k_busy_wait(CDCACM_TX_TIMEOUT_DELAY);
			timeout += CDCACM_TX_TIMEOUT_DELAY;
			if(timeout >= CDCACM_TX_TIMEOUT)
				goto done_write;
		}
	}
done_write:
	uart_irq_tx_disable(dev);
}

static void ipm_callback(void *context, uint32_t id, volatile void *data)
{
	char buffer[MBOX_MSG_LENGTH];
	uint8_t len = 0;
	for(int i = 0; i <MBOX_MSG_LENGTH; i++)
	{
		if((*(char*)(data+i)) != '\0')
		{
			uint8_t new_head = (uint8_t)(Tx_HEAD+1)%SBS;
			if(new_head != Tx_TAIL)
			{
				char tval = *(char*)(data+i);
				Tx_BUFF[Tx_HEAD] = tval;
				Tx_HEAD = new_head;
				buffer[len++] = tval;;
			}
			else
			{
				break;
			}
		}
		else
		{
			break;
		}
	}
}

void cdc_acm_tx()
{
	uint8_t write_buffer[BUFFER_LENGTH];
	int head = Tx_HEAD;
	int tail = Tx_TAIL;
	uint32_t dtr = 0;
	if (acm_tx_state == ACM_TX_READY) 
	{
		uart_line_ctrl_get(dev, LINE_CTRL_DTR, &dtr);
		if(dtr)
		{
			if(head!= tail)
			{
				k_busy_wait(CDCACM_TX_DELAY);
				uint8_t cnt = 0, index = Tx_TAIL;
				for (; (index != head) && (cnt < BUFFER_LENGTH);cnt++)
				{
					write_buffer[cnt] = Tx_BUFF[index];
					index = (index + 1)% SBS;
				}
				//try to write wait until their are 4 bytes to be written
				if((cnt >3) || (cdc_acm_tx_loop_timeout > CDCACM_TX_LOOP_TIMEOUT))
				{
					Tx_TAIL = (tail + cnt) % SBS;
					gpio_pin_write(gpio_dev, TXRX_LED, 0);	//turn TXRX led on
					write_data(dev, (const char*)write_buffer, cnt);
					gpio_pin_write(gpio_dev, TXRX_LED, 1);	//turn TXRX led off
					cdc_acm_tx_loop_timeout  = 0;
				}
				cdc_acm_tx_loop_timeout += CDCACM_TX_DELAY;
			}
			else
			{

			}
		}
	}
	else if (acm_tx_state == ACM_TX_DISABLED) 
	{
		Tx_TAIL = Tx_HEAD;
	}
}

void cdc_acm_rx()
{
	int bytes_read = 0;
	if (acm_rx_state == ACM_RX_READY)
	{
		read_data(dev, &bytes_read);
	}

	if(bytes_read)
	{
        char t_buff[MBOX_MSG_LENGTH];
		if(first_ipm_message)
		{
			t_buff[0] = '\0';
			first_ipm_message = false;
		}
		gpio_pin_write(gpio_dev, TXRX_LED, 0);	//turn TXRX led on
		if (!curie_shared_data->cdc_acm_buffers_obj.device_open) 
		{
			// ARC is not ready to receive this data - discard it
			bytes_read = 0;
		}
		else
		{
			int i = 0;
			int j = 0;
			while(bytes_read)
			{
				t_buff[i] = data_buf[j];
				bytes_read--;
				i++;
				j++;
				if(i == MBOX_MSG_LENGTH)
				{
					ipm_send(ipm, 1, 0, (uint8_t *)t_buff, MBOX_MSG_LENGTH);
					i = 0;
				}
			}
			if(i%MBOX_MSG_LENGTH)
			{
				//add a NULL character if message length is less than 16
				t_buff[i] = '\0';
				ipm_send(ipm, 1, 0, (uint8_t *)t_buff, MBOX_MSG_LENGTH);
			}
		}
		gpio_pin_write(gpio_dev, TXRX_LED, 1);	//turn TXRX led off
	}
	
}

void init_cdc_acm()
{
	// setup shared memory pointers for cdc-acm buffers
	curie_shared_data->cdc_acm_buffers = &curie_shared_data->cdc_acm_buffers_obj;
	curie_shared_data->cdc_acm_buffers_obj.rx_buffer = &curie_shared_data->cdc_acm_shared_rx_buffer;
	curie_shared_data->cdc_acm_buffers_obj.tx_buffer = &curie_shared_data->cdc_acm_shared_tx_buffer;
	curie_shared_data->cdc_acm_buffers_obj.host_open = false;
}

void cdcacm_setup(void *dummy1, void *dummy2, void *dummy3)
{
	uint32_t baudrate, dtr = 0;
	int ret;

	dev = device_get_binding(CONFIG_CDC_ACM_PORT_NAME);

	while (1) {
		uart_line_ctrl_get(dev, LINE_CTRL_DTR, &dtr);
		if (dtr)
			break;
		k_yield();
	}

	/* They are optional, we use them to test the interrupt endpoint */
	ret = uart_line_ctrl_set(dev, LINE_CTRL_DCD, 1);
	
	acm_tx_state = ACM_TX_READY;
	acm_rx_state = ACM_RX_READY;
	
	ret = uart_line_ctrl_set(dev, LINE_CTRL_DSR, 1);

	enableReboot = true;
	k_yield();

	gpio_dev= device_get_binding("GPIO_0");
	gpio_pin_configure(gpio_dev, TXRX_LED, (GPIO_DIR_OUT));
	gpio_pin_write(gpio_dev, TXRX_LED, 1);
    
	/* Wait 1 sec for the host to do all settings */
	k_busy_wait(1000000);

	ret = uart_line_ctrl_get(dev, LINE_CTRL_BAUD_RATE, &baudrate);

	uart_irq_callback_set(dev, interrupt_handler);
	flush_usb_txfifo();
	//reset head and tails values to 0
	Tx_TAIL = 0;
	Tx_HEAD = 0;
	usbSetupDone = true;
	curie_shared_data->cdc_acm_buffers_obj.host_open = true;
}

void baudrate_reset(void *dummy1, void *dummy2, void *dummy3)
{
	uint32_t baudrate, ret = 0;
	while(!enableReboot)
	{
		k_yield();
	}
	ret = uart_line_ctrl_get(dev, LINE_CTRL_BAUD_RATE, &baudrate);	
	while(1)
	{
		ret = uart_line_ctrl_get(dev, LINE_CTRL_BAUD_RATE, &baudrate);
		if(baudrate == RESET_BAUD)
		{
			soft_reboot();
		}
		k_sleep(BAUDRATE_RESET_SLEEP);
	}
}

void usb_serial(void *dummy1, void *dummy2, void *dummy3)
{
	while(!usbSetupDone)
	{
		k_yield();
	}

	/* Enable rx interrupts */
	uart_irq_rx_enable(dev);

	ipm = device_get_binding("cdc_ipm_send");
	rec_ipm = device_get_binding("cdc_ipm_receive");
	ipm_register_callback(rec_ipm, ipm_callback, NULL);
	ipm_set_enabled(rec_ipm, 1);

	while (1) 
	{
		uint32_t dtr = 0;
		uart_line_ctrl_get(dev, LINE_CTRL_DTR, &dtr);
		gpio_pin_write(gpio_dev, TXRX_LED, 1);	//turn TXRX led off
		if(dtr)
		{
			if(curie_shared_data->cdc_acm_buffers_obj.host_open == false)
			{
				flush_usb_txfifo();
				uart_line_ctrl_set(dev, LINE_CTRL_DCD, 1);
				uart_line_ctrl_set(dev, LINE_CTRL_DSR, 1);
				k_busy_wait(1000000);
				curie_shared_data->cdc_acm_buffers_obj.host_open = true;
			}
			else
			{
				cdc_acm_tx();
				cdc_acm_rx();
			}
		}
		else
		{
			if(curie_shared_data->cdc_acm_buffers_obj.host_open == true)
			{
				curie_shared_data->cdc_acm_buffers_obj.host_open = false;
				flush_usb_txfifo();
				uart_line_ctrl_set(dev, LINE_CTRL_DCD, 1);
				uart_line_ctrl_set(dev, LINE_CTRL_DSR, 1);
				k_busy_wait(1000000);
				Tx_TAIL = 0;
				Tx_HEAD = 0;
			}
		}
		k_yield();
	}
}
```

## src/cdcacm_serial.h
```c
#ifdef __cplusplus
extern "C" {
#endif

void cdc_acm_tx();

void cdc_acm_rx();

void init_cdc_acm();

void cdcacm_setup();

void baudrate_reset();

void usb_serial();

#ifdef __cplusplus
}
#endif
```

## src/curie_shared_mem.h
```c
/*
 * Copyright (c) Intel Corporation
 *
 * Licensed under the Apache License, Version 2.0 (the "License");
 * you may not use this file except in compliance with the License.
 * You may obtain a copy of the License at
 *
 *     http://www.apache.org/licenses/LICENSE-2.0
 *
 * Unless required by applicable law or agreed to in writing, software
 * distributed under the License is distributed on an "AS IS" BASIS,
 * WITHOUT WARRANTIES OR CONDITIONS OF ANY KIND, either express or implied.
 * See the License for the specific language governing permissions and
 * limitations under the License.
 */

#ifndef CURIE_SHARED_MEM_H_
#define CURIE_SHARED_MEM_H_

/* Start of the shared RAM */
#define SHARED_ADDR_START 0xA8000000

#define SERIAL_BUFFER_SIZE 256
#define SHARED_BUFFER_SIZE 64

struct cdc_ring_buffer
{
    /** Ring buffer data */
    volatile uint8_t data[SERIAL_BUFFER_SIZE];
    /** Ring buffer head index, modified by producer */
    volatile int head;
    /** Ring buffer tail index, modified by consumer */
    volatile int tail;
};

struct cdc_acm_shared_data {
    /** Ring buffer to pass CDC-ACM data from QRK to ARC */
    struct cdc_ring_buffer *rx_buffer;
    /** Ring buffer to pass CDC-ACM data from ARC to QRK */
    struct cdc_ring_buffer *tx_buffer;
    /** Boolean flag set by QRK when CDC-ACM host connection is opened */
    volatile int host_open;
    /** Boolean flag set by ARC when CDC-ACM endpoint connection is opened */
    volatile int device_open;
};

struct shared_ring_buffer
{
    /** Ring buffer data */
    volatile uint8_t data[SHARED_BUFFER_SIZE];
    /** Ring buffer head index, modified by producer */
    volatile int head;
    /** Ring buffer tail index, modified by consumer */
    volatile int tail;

    /** Buffer status
     * 0 - locked by X86 core
     * 1 - locked by arc core
     * 2 - available to be taken by any core
    **/
    volatile int flag;
};

struct smc_shared_data
{
    struct shared_ring_buffer *quark_buffer;
    struct shared_ring_buffer *arc_buffer;
};

struct platform_shared_block_ {
    /** Arc reset vector */
    unsigned int arc_start;
    /** Port table address */
    void * ports;
    /** Service table address */
    void * services;
    /** Port id of the service manager */
    uint16_t service_mgr_port_id;
    /** ARC boot synchronization flag.
     * This value is set to 0 prior to start ARC, and is polled until set to 1
     * by ARC in order to allow QRK to wait for ARC to be started. Useful for
     * debugging ARC startup code.
     */
    //uint8_t arc_ready;
    uint8_t flags;

    /** used to send suspend resume arc core
     * bit usage
     * [0-7] 	PM_POWERSTATE
     * [8-9] 	ACK
     * [16-31]	Magic number
     */
    uint32_t pm_request;

    /** ARC wakelocks status info variables
     * Used in order to share if any wakelock
     * is taken, on ARC side.
     */
    uint8_t any_arc_wakelock_taken;

    /** QRK wakelocks status info variables
     * Used in order to share if any wakelock
     * is taken, on QRK side.
     */
    uint8_t any_qrk_wakelock_taken;

    /* Pointer to shared structure used by CDC-ACM.
     *
     * The QRK core is responsible for allocating memory and initialising the
     * pointers of this structure.
     * The ARC core counts on QRK to find valid pointers in place.
     */
    struct cdc_acm_shared_data	*cdc_acm_buffers;

    struct cdc_acm_shared_data cdc_acm_buffers_obj;

    struct cdc_ring_buffer cdc_acm_shared_rx_buffer;
    struct cdc_ring_buffer cdc_acm_shared_tx_buffer;

    struct smc_shared_data *smc_shared_data_ptr;

    struct smc_shared_data smc_shared_data_obj;

    struct shared_ring_buffer quark_to_ARC;
    struct shared_ring_buffer ARC_to_quark;
    
    uint32_t arc_cpu_context[33];
    
    uint32_t pm_status;
    
    void* arc_restore_addr;
    
    void* quark_restore_addr;
    
    uint32_t pm_int_status;

    uint8_t error_code;
};


#define ARC_READY	(1 << 0)

#define curie_shared_data ((struct platform_shared_block_ *) SHARED_ADDR_START)

#endif
```

## src/factory_data.h
```c
/*
 * Copyright (c) 2015, Intel Corporation. All rights reserved.
 *
 * Redistribution and use in source and binary forms, with or without
 * modification, are permitted provided that the following conditions are met:
 *
 * 1. Redistributions of source code must retain the above copyright notice,
 * this list of conditions and the following disclaimer.
 *
 * 2. Redistributions in binary form must reproduce the above copyright notice,
 * this list of conditions and the following disclaimer in the documentation
 * and/or other materials provided with the distribution.
 *
 * 3. Neither the name of the copyright holder nor the names of its contributors
 * may be used to endorse or promote products derived from this software without
 * specific prior written permission.
 *
 * THIS SOFTWARE IS PROVIDED BY THE COPYRIGHT HOLDERS AND CONTRIBUTORS "AS IS"
 * AND ANY EXPRESS OR IMPLIED WARRANTIES, INCLUDING, BUT NOT LIMITED TO, THE
 * IMPLIED WARRANTIES OF MERCHANTABILITY AND FITNESS FOR A PARTICULAR PURPOSE
 * ARE DISCLAIMED. IN NO EVENT SHALL THE COPYRIGHT HOLDER OR CONTRIBUTORS BE
 * LIABLE FOR ANY DIRECT, INDIRECT, INCIDENTAL, SPECIAL, EXEMPLARY, OR
 * CONSEQUENTIAL DAMAGES (INCLUDING, BUT NOT LIMITED TO, PROCUREMENT OF
 * SUBSTITUTE GOODS OR SERVICES; LOSS OF USE, DATA, OR PROFITS; OR BUSINESS
 * INTERRUPTION) HOWEVER CAUSED AND ON ANY THEORY OF LIABILITY, WHETHER IN
 * CONTRACT, STRICT LIABILITY, OR TORT (INCLUDING NEGLIGENCE OR OTHERWISE)
 * ARISING IN ANY WAY OUT OF THE USE OF THIS SOFTWARE, EVEN IF ADVISED OF THE
 * POSSIBILITY OF SUCH DAMAGE.
 */

#ifndef __FACTORY_DATA_H__
#define __FACTORY_DATA_H__


#include <stdint.h>

#define CUSTOMER_DATA_ADDRESS 0xFFFFE200

/**
 * Contains Customer data.
 * size: 512 bytes
 */
typedef struct {
    /** product serial number
     * Up to 16 ASCII characters. If its length is < 16, it is NULL terminated.*/
    uint8_t product_sn[16];

    /** product hardware version
     * hexadecimal value, left-padded */
    uint8_t product_hw_ver[4];

    uint8_t reserved[12];

    uint8_t board_name[32];

    uint8_t vendor_name[32];

    uint32_t product_sn_len;

    uint32_t board_name_len;

    uint32_t vendor_name_len;

    uint16_t product_vid;

    uint16_t product_pid;

    uint8_t reserved_1[384];

    uint32_t patternKeyStart;

    uint32_t blockVersionHi;

    uint32_t blockVersionLow;

    uint32_t patternKeyEnd;

} customer_data_t;


#endif /* __FACTORY_DATA_H__ */
```

## src/fault_led.c
```c
/*
 * Copyright (c) 2017 Intel Corporation
 *
 * Licensed under the Apache License, Version 2.0 (the "License");
 * you may not use this file except in compliance with the License.
 * You may obtain a copy of the License at
 *
 *     http://www.apache.org/licenses/LICENSE-2.0
 *
 * Unless required by applicable law or agreed to in writing, software
 * distributed under the License is distributed on an "AS IS" BASIS,
 * WITHOUT WARRANTIES OR CONDITIONS OF ANY KIND, either express or implied.
 * See the License for the specific language governing permissions and
 * limitations under the License.
 */

#include <zephyr.h>
#include <gpio.h>
#include <stdint.h>
#include <fault_led.h>
#include "curie_shared_mem.h"

#define FAULT_LED	26

#define BLINK_DELAY	250
#define CHECK_DELAY	3000

struct device *gpio_dev;

int led_state = 0;

void check_arc_error(void *dummy1, void *dummy2, void *dummy3)
{
	while(1)
	{
		uint8_t error_code = curie_shared_data->error_code;
		if(error_code)
			blink_fault(error_code);

		k_sleep(CHECK_DELAY);
	}
}

void blink_fault(int error_code)
{
	gpio_dev= device_get_binding("GPIO_0");
	gpio_pin_configure(gpio_dev, FAULT_LED, (GPIO_DIR_OUT));
	if(error_code == 1)
	{
		gpio_pin_write(gpio_dev, FAULT_LED, 0);	//turn TXRX led on
		return;
	}
	for(int i = 0; i < error_code; i++)
	{
		
		gpio_pin_write(gpio_dev, FAULT_LED, 0);	//turn TXRX led on
		k_sleep(BLINK_DELAY);
		gpio_pin_write(gpio_dev, FAULT_LED, 1);	//turn TXRX led off
		k_sleep(BLINK_DELAY);
	}
}
```

## src/fault_led.h
```c
/*
 * Copyright (c) 2017 Intel Corporation
 *
 * Licensed under the Apache License, Version 2.0 (the "License");
 * you may not use this file except in compliance with the License.
 * You may obtain a copy of the License at
 *
 *     http://www.apache.org/licenses/LICENSE-2.0
 *
 * Unless required by applicable law or agreed to in writing, software
 * distributed under the License is distributed on an "AS IS" BASIS,
 * WITHOUT WARRANTIES OR CONDITIONS OF ANY KIND, either express or implied.
 * See the License for the specific language governing permissions and
 * limitations under the License.
 */

#ifdef __cplusplus
extern "C" {
#endif

void check_arc_error(void *dummy1, void *dummy2, void *dummy3);

void blink_fault(int error_code);

#ifdef __cplusplus
}
#endif
```

## src/sharedmemory_com.c
```c
#include <zephyr.h>

#include "curie_shared_mem.h"

#if defined(CONFIG_STDOUT_CONSOLE)
#include <stdio.h>
#define PRINT           printf
#else
#include <misc/printk.h>
#define PRINT           printk
#endif

#define QUARK_BUFF 	curie_shared_data->quark_to_ARC.data
#define QUARK_BUFF_HEAD	curie_shared_data->quark_to_ARC.head
#define QUARK_BUFF_TAIL	curie_shared_data->quark_to_ARC.tail
#define QUARK_BUFF_FLAG	curie_shared_data->quark_to_ARC.flag
#define ARC_BUFF	curie_shared_data->ARC_to_quark.data
#define ARC_BUFF_HEAD	curie_shared_data->ARC_to_quark.head
#define ARC_BUFF_TAIL	curie_shared_data->ARC_to_quark.tail
#define ARC_BUFF_FLAG	curie_shared_data->ARC_to_quark.flag

#define QUARK_CORE

void init_sharedMemory_com()
{
  // initialize pointers to shared memory structure
  curie_shared_data->smc_shared_data_ptr= &curie_shared_data->smc_shared_data_obj;
  curie_shared_data->smc_shared_data_obj.quark_buffer = &curie_shared_data->quark_to_ARC;
  curie_shared_data->smc_shared_data_obj.arc_buffer = &curie_shared_data->ARC_to_quark;

  // initiliaze  some values
  QUARK_BUFF_HEAD = 0;
  QUARK_BUFF_TAIL = 0;
  QUARK_BUFF_FLAG = 2;
  ARC_BUFF_HEAD = 0;
  ARC_BUFF_TAIL = 0;
  ARC_BUFF_FLAG = 2;
}

int smc_availableForRead()
{
	return (int)(SHARED_BUFFER_SIZE + ARC_BUFF_HEAD-ARC_BUFF_TAIL) % SHARED_BUFFER_SIZE;
}

int smc_write(uint8_t data)
{
  //check if buffer is available
  if(QUARK_BUFF_FLAG == 1)
    return 1;

  //lock the buffer
  QUARK_BUFF_FLAG = 0;

  int new_head = (int)(QUARK_BUFF_HEAD+1)%SHARED_BUFFER_SIZE;
  if(new_head != QUARK_BUFF_TAIL)
  {
    QUARK_BUFF[QUARK_BUFF_HEAD] = data;
    QUARK_BUFF_HEAD = new_head;
    QUARK_BUFF_FLAG = 2; //unlock the buffer
    return 0;
  }
  else
  {
    QUARK_BUFF_FLAG = 2; //unlock the buffer
    return 2; //buffer is full
  }
}

uint8_t smc_read()
{
  //check if buffer is available
  if(ARC_BUFF_FLAG == 1)
    return 0;

  //lock the buffer
  ARC_BUFF_FLAG = 0;
  
  if(smc_availableForRead())
  {
    uint8_t data = ARC_BUFF[ARC_BUFF_TAIL];
    ARC_BUFF_TAIL = (ARC_BUFF_TAIL + 1)%SHARED_BUFFER_SIZE;
    ARC_BUFF_FLAG = 2; //unlock the buffer
    return data;
  }
  else
  {
    ARC_BUFF_FLAG = 2; //unlock the buffer
    return 0;
  }
}
```

## src/sharedmemory_com.h
```c
#ifndef _SHAREDMEMORY_SMC_
#define _SHAREDMEMORY_SMC_

#include <stdint.h>

#ifdef __cplusplus
extern "C" {
#endif

void init_sharedMemory_com();

int smc_availableForRead();

int smc_write(uint8_t data);

uint8_t smc_read();

#ifdef __cplusplus
}
#endif

#endif /* _SHAREDMEMORY_SMC_ */
```

## src/soc_ctrl.c
```c
#include <soc_ctrl.h>

#include "soc.h"
#include "curie_shared_mem.h"

void start_arc(unsigned int reset_vector)
{

	if (reset_vector != 0) {
		curie_shared_data->arc_start = reset_vector;
	}

	curie_shared_data->flags = 0;
	k_busy_wait(ARCSTART_DELAY);

	*SCSS_SS_CFG_REG |= ARC_RUN_REQ_A;

	k_busy_wait(ARCSTART_DELAY);
}

void halt_arc()
{
	*SCSS_SS_CFG_REG |= ARC_HALT_REQ_A;
}

void soft_reboot()
{
	halt_arc();
	*SCSS_RSTC = RSTC_WARM_RESET;
}
```
